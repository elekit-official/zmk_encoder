## Kconfig
```kconfig
# Copyright (c) 2026 Your Name
# SPDX-License-Identifier: MIT

config ZMK_BEHAVIOR_ENCODER_MOUSE_SCROLL
    bool "Encoder Mouse Scroll behavior"
    default y
    depends on ZMK_POINTING
    help
      Enables the one-shot encoder mouse scroll behavior.
```

## dts/bindings/behaviors/zmk,behavior-encoder-mouse-scroll.yaml
```yaml
# Copyright (c) 2026 Your Name
# SPDX-License-Identifier: MIT

description: Encoder Mouse Scroll Behavior (One-shot)

compatible: "zmk,behavior-encoder-mouse-scroll"

properties:
  "#sensor-binding-cells":
    type: int
    required: true
    const: 2

sensor-binding-cells:
  - param1
  - param2
```
